## Kconfig
```kconfig
config POLARIS_LED4_STATUS
    bool "Polaris left four-LED split status flow"
    depends on ZMK_ANIMATION && ZMK_SPLIT_ROLE_CENTRAL
    depends on ZMK_SPLIT_BLE_CENTRAL_BATTERY_LEVEL_FETCHING
```

## dts/bindings/animations/te9no,polaris-led4-status.yaml
```yaml
description: Left-only four-pixel rainbow, split connection and battery status flow
compatible: "te9no,polaris-led4-status"
```
